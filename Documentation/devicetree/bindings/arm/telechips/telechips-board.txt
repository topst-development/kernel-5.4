## Documentation/devicetree/bindings/arm/telechips/telechips-board.txt
```
Telechips Reference Boards Bindings
==============================================================================

Required root node properties:
    - compatible = should be one or more of the following.
        - "telechips,tcc8971"
        - "telechips,tcc8031"
        - "telechips,tcc8050"
        - "telechips,tcc8053"
        - "telechips,tcc8059"
```

## Documentation/devicetree/bindings/char/cam_ipc.txt
```
* Device Tree Bindings for Camera IPC Manager

  Camera IPC Manager (a.k.a. cam_ipc) is a device driver to communicate between
  mcu and sub-core, which is needed for trust RVC or communicate between main and sub-core,
  which is needed for ovp changed in RVC since TCC805X.

  Trust RVC checks the state of sub-core by transferring a request message to
  sub-core via mailbox. Then, sub-core sends back an ACK to MCU. If the message
  cannot receive by MCU, Trust RVC will recognize the state of subcore as safety
  state, it will control the video mux and change the display bus from DDIBUS to
  Trust RVC.

  During RVC operation, the sub-core sends a request message to the main-core 
  for an ovp change request via mailbox. Then, main-core receives a request message,
  performs an ovp change, and returns the result value.

Required properties:

- status     : disable or enable the device node
- compatible : property name that conveys the platform architecture identifiers,
               as 'telechips,cam_ipc'
- mbox-names : the name of mailbox
- mboxes     : specifies the channel for the mailbox (IPC)
- mbox-id    : specifies the mailbox id for camera ipc manager
- device-name: the name of the device

Example
-------
  cam_ipc0: cam_ipc@0 {
    compatible = "telechips,cam_ipc";
    device-name ="cam_ipc_ap";
    mbox-names ="cam-ipc-ap";
    mboxes = <&cb_mbox TCC_CB_MBOX_CAMIPC>;
    mbox-id = TCC_MBOX_CAMIPC_ID;
    status = "disabled";
  };

  cam_ipc1: cam_ipc@1 {
    compatible = "telechips,cam_ipc";
    device-name ="cam_ipc_micom";
    mbox-names ="cam-ipc-micom";
    mboxes = <&micom_mbox TCC_MICOM_MBOX1_CAMIPC>;
    mbox-id = TCC_MBOX_CAMIPC_ID;
    status = "disabled";
  };
```

## Documentation/devicetree/bindings/char/tcc_aux_detect/aux_detect.txt
```
Telechips aux_detect device

Required property:
- compatible:
		telechpis,aux_detect

- pinctrl-0:
		<&aux_detect_pin>

- aux-gpios:
		aux detect gpio

Example:
		aux_detect {
			compatible = "telechips,aux_detect";
			status = "okay";

			pinctrl-names = "default";
			pinctrl-0 = <&aux_detect_pin>;

			aux-gpios = <&gpmb 11 1>;
			aux-active = <1>;
		};
```

## Documentation/devicetree/bindings/char/tcc_ecid.txt
```
* Telechips ECID Driver

Provides a tool to read CPU ID through ECID driver.

Required properties:
- compatible : "telechips,tcc-cpu-id"
- reg : physical base address of the controller and length of memory mapped
	region.

Example:
	cpu_id: cpu-id@14200290{
		compatible = "telechips,tcc-cpu-id";
		reg = <0x0 0x14200290 0x0 0x4>,
		    <0x0 0x14200298 0x0 0x4>,
		    <0x0 0x1420029C 0x0 0x4>,
		    <0x0 0x14400014 0x0 0x4>;
		status = "okay";
	};
```

## Documentation/devicetree/bindings/char/tcc_screen_share.txt
```
This is for 'telechips,tcc_scrshare'.

Required properties for display:
	-compatible:
		"telechips,tcc_scrshare"

-------------------------------------------------------------------------------

Example:
	tcc_scrshare0: tcc_scrshare0 {
		compatible = "telechips,tcc_scrshare";
		device-name ="tcc_scrshare_main";
		mbox-names ="main-scrshare";
		mboxes = <&cb_mbox TCC_CB_MBOX_SCRSHARE>;
		mbox-id = TCC_MBOX_SCRSHARE_ID;
		overlay_driver_names = "/dev/overlay";
		status = "disabled";
    };
```

## Documentation/devicetree/bindings/input/tc_touch_share/tc_touch_bridge.txt
```
Telechips Touch Sharing Handler

Required properties:
- compatible:
    telechips,tcc_touch_bridge

- mbox-names:
	tb-mbox

- mboxes:
	<&cb_mbox TCC_CB_MBOX_TCHSHARE>

- mbox-id:
	TCC_MBOX_TCHSHARE_ID

Example:
	tstb:tcc_touch_bridge {
		compatible = "telechips,tcc_touch_bridge";
		mbox-names ="tb-mbox";
		mboxes = <&cb_mbox TCC_CB_MBOX_TCHSHARE>;
		mbox-id = TCC_MBOX_TCHSHARE_ID;
	};
};
```

## Documentation/devicetree/bindings/media/i2c/cxd5700.txt
```
* Device Tree Bindings for CXD5700

CXD5700 is camera image sensor. Basically, it is disabled
by default for Telechips EVB.

Required properties:

- status     : disable or enable the device node
- compatible : property name that conveys the platform architecture identifiers,
               as 'sony,cxd5700'
- reg        : I2C slave address
- port       : specifies the endpoint of the sensor (output only)

example
-------
	cxd5700: cxd5700 {
		status		= "disabled";
		compatible	= "sony,cxd5700";
		reg		= <0x18>;
		port {
			cxd5700_out0: endpoint {
				remote-endpoint = <&max9275_in0>;
				io-direction	= "output";
			};
		};
	};
```

## Documentation/devicetree/bindings/misc/gpio-sample.txt
```
Telechips GPIO Sample driver

Required properties:

- compatible : should be "gpio_sample".
- interrupt-parent : indicates interrupt parent of interrupt source.
- interrupts : describes interrupt source.
- gpios : describes GPIO used by GPIO sample driver for normal uses that include changing direction
and value of the GPIO.

    tcc_gpio_sample {
	compatible = "gpio_sample";
	leble = "TCC GPIO";
	interrupt-parent = <&gpa>;
	interrupts = <1 IRQ_TYPE_EDGE_BOTH>;
	gpios = <&gpa 2 0>;
    };
```

## Documentation/devicetree/bindings/misc/tccmisc_drv.txt
```
This is for 'telechips,tccmisc'.

Required properties for display:
	-compatible:
		"telechips,tccmisc"

-------------------------------------------------------------------------------

Example:
	tccmisc:tccmisc {
		/* Only use kernel-5.4 or up */
		compatible = "telechips,tccmisc";
		status = "okay";
	};
```

## Documentation/devicetree/bindings/phy/tcc-dwc_otg-phy.txt
```
Telechips USB DWC OTG PHY

Required properties:
 - compatible:  must be "telechips,tcc_dwc_otg_phy"
 - reg:         physical base addresses of the controller and length of memory
                mapped region

Optional properties:

Example:

dwc_otg_phy: dwc_otg_phy@11DA0100 {
	compatible = "telechips,tcc_dwc_otg_phy";
	reg = <0x 0x11DA0100 0x 0x30>;
	status = "disabled";
};
```

## Documentation/devicetree/bindings/phy/tcc-ehci-phy.txt
```
Telechips USB EHCI PHY

Required properties:
 - compatible:  must be "telechips,tcc_ehci_phy"
 - reg:         physical base addresses of the controller and length of memory
                mapped region
 - interrupts:  interrupt should be described here

Optional properties:
 - mux_port:    MUX port feature for USB 2.0 DRD port

Example:

ehci_phy: ehci_phy@11DA0010 {
	compatible = "telechips,tcc_ehci_phy";
	reg = <0x0 0x11DA0010 0x0 0x30>;
	interrupts = <GIC_SPI 143 IRQ_TYPE_LEVEL_HIGH>;
	status = "disabled";
};

mhst_phy: mux_host_phy@11DA00DC {
	compatible = "telechips,tcc_ehci_phy";
	reg = <0x0 0x11DA00DC 0x0 0x20>;
	interrupts = <GIC_SPI 148 IRQ_TYPE_LEVEL_HIGH>;
	mux_port;
	status = "disabled";
};
```

## Documentation/devicetree/bindings/power/reset/telechips,reboot-mode.txt
```
Telechips reboot mode driver

The driver gets reboot mode magic value from reboot-mode driver and store it.
Then the bootloader can read it and take different action according to the magic
value stored.

Required properties:
- compatible: Should be "telechips,reboot-mode"
- mode-xxx: Magic value for xxx reboot mode.  Refer to reboot-mode.txt.

Optional properties:
- record-panic: Magic value for kernel panic.

Example:
	reboot-mode {
		compatible = "telechips,reboot-mode";
		mode-normal = <BOOT_NORMAL>;
		mode-bootloader = <BOOT_FASTBOOT>;
		mode-recovery = <BOOT_RECOVERY>;
		record-panic = <BOOT_PANIC>;
	};
```

## Documentation/devicetree/bindings/reserved-memory/optee.os.txt
```
*** OP-TEE OS Region Device Tree Bindings ***

Telechips OP-TEE OS is loaded in the middle of memory.
REE(Normal World) cannot use the corresponding area, so it should be set as
reserved memory.

Properties:
compatible (required) - should contain "optee.os"
reg (required) - standard definition
no-map (optional) - empty property
    - Indicates the operating system must not create a virtual mapping
      of the region as part of its standard mapping of system memory,
      nor permit speculative access to it under any circumstances other
      than under the control of the device driver using the region.
status (optional) - standard definition
    - bootloader can be set the status to "okay" when OPTEE OS is running
      even if the status is "disabled".

Example:
	reserved_memory: reserved-memory {
		    :
		reserved_optee: optee_os {
			compatible = "optee.os";
			reg = <0x0 0x2e000000 0x0 0x02000000>;
			no-map;
			status = "disabled";
		};
	};
```

## Documentation/devicetree/bindings/sound/ak4601.txt
```
AK4601 Audio Codec

This device supports I2C mode.

Required properties:

- compatible : "akm,ak4601"
- reg : The I2C address of the device for I2C

Optional properties:
- ak4601,pdn-gpio: A GPIO specifier for the power down & reset pin
- cmute-gpios: A GPIO specifier for the codec mute pin
- amute-gpios: A GPIO specifier for the mute pin for PowerAMP
- stanby-gpios: A GPIO specifier for the stanby pin for PowerAMP

Example:

&i2c {
	status = "okay";
	...
		ak4601: ak4601@10 {
			compatible = "akm,ak4601";
			ak4601,pdn-gpio = <&gpe 14 0>;
			cmute-gpios = <&gpe 15 1>;
			//CODEC_MUTE    0: active high, 1: active low
			amute-gpios = <&gpma 1 0>;
			//AMP_MUTE      0: active high, 1: active low
			stanby-gpios = <&gpma 2 0>;
			//AMP_STBY      0: active high, 1: active low
			reg = <0x10>;
		};
};
```

## Documentation/devicetree/bindings/sound/ak7604.txt
```
AK7604 mini DSP

This device supports I2C mode.

Required properties:

- compatible : "akm,ak7604"
- reg : The I2C address of the device for I2C


Example:

&i2c {
	status = "okay";
	...
		ak7604: ak7604@1c {
			compatible = "akm,ak7604";
			reg = <0x1c>;
		};
};
```

## Documentation/devicetree/bindings/thermal/tcc-thermal.txt
```
* Temperature Sensor on Telechips SoCs

- compatible : "telechips,tcc-thermal";
- reg : physical base address of the controller and length of memory mapped
	region.
- interrupts : The interrupt number to the cpu.The interrupt specifier format
	depends on the interrupt controller
- throttle_count : Number of throttling table.
- throttle_passive_count : The number of throttle_tables associated with
	throttling.
	Thermal sensor driver supports throttling function.
- cal_type : Type of calibration.
	1. TCC802x/TCC803x/TCC897x support one-point trimming calibration
		TYPE_ONE_POINT_TRIMMING
	2. TCC805x supports two-points trimming calibration
		TYPE_TWO_POINT_TRIMMING
- throttle_table : Operation table according to the temperature
	temp means temperature for operation.
	freq_max_cluster0 is the maximum CPU clock depending on the temperature.
	If it reaches the temperature, the throttling function lowers the CPU
	clock.
- polling-delay-idle : The maximum number of milliseconds to wait between polls
	when checking this thermal zone.
	If you want to use polling check (for throttling or shutdown function),
	set this value.
- polling-delay-passive : The maximum number of milliseconds to wait between
	polls when performing passive cooling (throttling).

Example:
thermal: thermal@14700000 {
		 compatible = "telechips,tcc-thermal";

		 sc-firmware = <&tcc_sc_fw>;

		 reg = <0x0 0x14700000 0x0 0x4>, //0:Enable register
		     <0x0 0x14700004 0x0 0x4>, //1:Control register
		     <0x0 0x1470000C 0x0 0x4>, //2:Probe select register
		     <0x0 0x147000D0 0x0 0x4>,
		     <0x0 0x147000D4 0x0 0x4>,
		     <0x0 0x147000D8 0x0 0x4>,
		     <0x0 0x147000DC 0x0 0x4>,
		     <0x0 0x147000E0 0x0 0x4>,
		     <0x0 0x147000E4 0x0 0x4>, //3-8:TSENSOR Data register
		     <0x0 0x14700024 0x0 0x4>, //9:Interrupt Eable register
		     <0x0 0x14700034 0x0 0x4>, //10:Interrupt Status register
		     <0x0 0x14700050 0x0 0x4>,
		     <0x0 0x14700054 0x0 0x4>, // 11, 12:Threshold Data register(MAIN)
		     <0x0 0x14700058 0x0 0x4>,
		     <0x0 0x1470005C 0x0 0x4>, // 13, 14:Threshold Data register(Probe0)
		     <0x0 0x14700060 0x0 0x4>,
		     <0x0 0x14700064 0x0 0x4>, // 15, 16:Threshold Data register(Probe1)
		     <0x0 0x14700068 0x0 0x4>,
		     <0x0 0x1470006C 0x0 0x4>, // 17, 18:Threshold Data register(Probe2)
		     <0x0 0x14700070 0x0 0x4>,
		     <0x0 0x14700074 0x0 0x4>, // 19, 20:Threshold Data register(Probe3)
		     <0x0 0x14700078 0x0 0x4>,
		     <0x0 0x1470007C 0x0 0x4>, // 21, 22:Threshold Data register(Probe4)
		     <0x0 0x14700044 0x0 0x4>, // 23:Interrupt Clear register
		     <0x0 0x1470002C 0x0 0x4>, // 24:Interrupt Mask register
		     <0x0 0x14700154 0x0 0x4>; // 25:Interval time register

		 status = "okay";

		 throttle_count = <5>;
		 throttle_active_count = <0>;
		 throttle_passive_count = <5>;
		 interrupts = <GIC_SPI 40 0>;
		 cal_type = "TYPE_TWO_POINT_TRIMMING";
		 polling-delay-idle = <600>;
		 polling-delay-passive = <1000>;
		 core = "CPU0";

		 threshold_high_temp = <75>;
		 threshold_low_temp = <(-15)>;
		 interval_time = <262143>;

		 throttle_table {
			 throttle_tab_0 {
				 temp = <0>;
				 freq_max_cluster0 = <1690>;
			 };
			 throttle_tab_1 {
				 temp = <75>;
				 freq_max_cluster0 = <1500>;
			 };
			 throttle_tab_2 {
				 temp = <80>;
				 freq_max_cluster0 = <1460>;
			 };
			 throttle_tab_3 {
				 temp = <85>;
				 freq_max_cluster0 = <950>;
			 };
			 throttle_tab_4 {
				 temp = <125>;
				 freq_max_cluster0 = <950>;
			 };
		 };
	 };
```

## Documentation/devicetree/bindings/usb/tcc-dwc2.txt
```
Telechips USB DWC2 controller

Required properties:
 - compatible:          must be "telechips,dwc2"
 - reg:                 physical base addresses of the controller and length of
                        memory mapped region
 - interrupts:          interrupt should be described here
 - phy:                 phy provider specifier
 - phy-names:           must be "usb2-phy"
 - telechips,mhst_phy:	must be <&mhst_phy>

Optional properties:

Example:

dwc_otg: dwc_otg@11980000 {
	compatible = "telechips,dwc2";
	reg = <0x0 0x11980000 0x0 0xCFFF>,
		<0x0 0x11900000 0x0 0x108>,
		<0x0 0x11940000 0x0 0x60>;
	interrupts = <GIC_SPI 145 IRQ_TYPE_LEVEL_HIGH>,
			<GIC_SPI 147 IRQ_TYPE_LEVEL_HIGH>;
	phy = <&dwc_otg_phy>;
	phy-names = "usb2-phy";
	telechips,mhst_phy = <&mhst_phy>;
	status = "disabled";
};
```

## Documentation/devicetree/bindings/usb/tcc-ehci.txt
```
Telechips USB EHCI controller

Required properties:
 - compatible:          must be "telechips,tcc-ehci"
 - reg:                 physical base addresses of the controller and length of
                        memory mapped region
 - interrupts:          interrupt should be described here
 - telechips,ehci_phy:	must be <&ehci_phy>

Optional properties:
 - tpl-support:         TPL(Targeted Peripheral List) feature for targeted hosts

Example:

ehci: ehci@11A00000 {
	compatible = "telechips,tcc-ehci";
	reg = <0x0 0x11A00000 0x0 0x108>,
		<0x0 0x11DA0010 0x0 0x54>;
	interrupts = <GIC_SPI 142 IRQ_TYPE_LEVEL_HIGH>;
	telechips,ehci_phy = <&ehci_phy>;
	status = "disabled";
	tpl-support;
};
```

## Documentation/devicetree/bindings/watchdog/telechips,tcc805x_cbus_wdt.txt
```
* Telechips Watchdog Timer for TCC805x(CBUS Watchdog)

The watchdog timer used for reset the CA72, CA53 processor on TCC805x in the
event of software malfunction. CA72 uses CBUS WDT0, and CA53 uses CBUS WDT4
each other.

[TCC8050 / TCC8053]
On CA72,
	***************  kick	*************
--------* SMU Timer 0 *-------->* CBUS WDT0 *
	***************		*************

On CA53,
	***************  kick	*************
--------* SMU Timer 1 *-------->* CBUS WDT4 *
	***************		*************

[TCC8059]
On CA72,
	***************  kick	*************
--------* SMU Timer 2 *-------->* CBUS WDT0 *
	***************		*************

On CA53,
	***************  kick	*************
--------* SMU Timer 1 *-------->* CBUS WDT4 *
	***************		*************



Required properties:
- compatible: Must be "telechips,tcc-cb-wdt"

- reg: Physical base address of the watchdog control register.

- interrupts: Interrupt # for watchdog kick timer.

- clock-names: Clock attribute name used for specifying watchdog and timer for
	kick watchdog.

- clocks: Information about clock ID used by kernel clock driver.
	Refer 'clocks' node on Telechips device tree.
	(arch/arm64/boot/dts/tcc/tcc805x.dtsi).

- clock-frequency: Set appropriate clock frequency for watchdog kick timer.
	By default, kick timer set to 12MHz. Changing this frequency might
	cause unstable result on kick time interval.

- kick-timer-id: Watchdog kick timer id for each core. 0 or 2 for CA72 kick watchdog
	timer, 1 for CA53 watchdog kick timer.
	The size of kick-timer-id is 1 byte.

- pretimeout-sec: Watchdog time to be kicked(=cleared).
	The minimum value of pretimeout-sec is 1 seconds.
	the maximum value of pretimeout-sec can change by clock rate of PERI_TCT.

- timeout-sec: Time until watchdog interrupt occurs.
	If the device tree provide invalid timeout-sec, watchdog driver will
	reset it's value to default.(20 seconds)
	The minimum value of timeout-sec is 5 seconds.
	The Maximum value of timeout-sec can change by clock rate of PERI_CB_WDT.


Example:
- Main core : arch/arm64/boot/dts/tcc/tcc805x.dtsi
...
        cb_watchdog: cb_watchdog@0x17010000 {
                compatible = "telechips,tcc-cb-wdt";
                reg = <0x0 0x17010000 0x0 0x10>,
                        <0x0 0x14300000 0x0 0x10>,
                        <0x0 0x14300060 0x0 0x4>;
                interrupts = <GIC_SPI 33 IRQ_TYPE_LEVEL_HIGH>;
                clock-names = "clk_wdt", "clk_kick";
                clocks = <&clk_peri PERI_CB_WDT>, <&clk_peri PERI_TCT>;
                clock-frequency = <24000000>;
                status = "okay";

                kick-timer-id = /bits/ 8 <0x0>;
                pretimeout-sec = <5>;
                timeout-sec = <20>;
        };
...
- Subcore : arch/arm64/boot/dts/tcc/tcc8050-linux-subcore-a53q_sv1.0.dts
...
        cb_watchdog: cb_watchdog4@0x17050000 {
                compatible = "telechips,tcc-cb-wdt";
                reg = <0x17050000 0x10>,
                        <0x14300010 0xC>,
                        <0x14300060 0x4>;
                interrupts = <GIC_SPI 34 IRQ_TYPE_LEVEL_HIGH>;
                clock-names = "clk_wdt", "clk_kick";
                clocks = <&clk_peri PERI_CB_WDT>, <&clk_peri PERI_TCT>;
                clock-frequency = <24000000>;

                kick-timer-id = /bits/ 8 <0x1>;
                pretimeout-sec = <5>;
                timeout-sec = <20>;
        };
...
```

## Documentation/devicetree/bindings/watchdog/telechips,tcc_pmu_wdt.txt
```
* Telechips Watchdog Timer for using PMU Watchdog.

The watchdog timer used for reset the Main processor on TCC in the event
of software malfunction. Watchdog on TCC Main processor use PMU Watchdog and
SMU Timer.

Required properties:
- compatible: Must be "telechips,wdt".
- reg: Physical base address of the watchdog control register and timer control
        register.
- clocks: Clock id for using watchdog timer.
- clock-frequency: Clock frequency for watchdog timer.
- interrupts: Interrupt # for watchdog kick timer(SMU timer)
- int-offset: SMU Watchdog timer interrupt bit offset in TIREQ register
- clear-bit: SMU Watchdog timer clear bit offset in TWDCLR register
- have-rstcnt-reg: Chipset that has reset counter register which released after
        TCC899x

Example:
        watchdog@74400008 {
                compatible = "telechips,wdt";
                reg = <0x144000D8 0x4>,  /* PMU_WDTCTRL */
                      <0x14300060 0x1C>, /* TIREQ */
                      <0x14300070 0xC>;  /* TWDCFG*/
                clocks = <&clk_peri PERI_TCX &clk_peri PERI_TCT>;
                clock-frequency = <366>; /* 24MHz / 65536 */
                interrupts = <GIC_SPI 0 IRQ_TYPE_LEVEL_HIGH>;
                int-offset = <6>;
                clear-bit = <0>;
                status = "okay" | "disabled";
        };
```

## arch/arm/configs/tcc897x_linux_cluster_lcn3_defconfig
```kconfig
CONFIG_LOCALVERSION="-tcc"
# CONFIG_LOCALVERSION_AUTO is not set
# CONFIG_SWAP is not set
CONFIG_SYSVIPC=y
CONFIG_AUDIT=y
CONFIG_NO_HZ=y
CONFIG_HIGH_RES_TIMERS=y
CONFIG_PREEMPT=y
CONFIG_IKCONFIG=y
CONFIG_IKCONFIG_PROC=y
CONFIG_CGROUPS=y
CONFIG_MEMCG=y
CONFIG_BLK_CGROUP=y
CONFIG_CGROUP_SCHED=y
CONFIG_RT_GROUP_SCHED=y
CONFIG_CGROUP_PIDS=y
CONFIG_CGROUP_RDMA=y
CONFIG_CGROUP_FREEZER=y
CONFIG_CPUSETS=y
CONFIG_CGROUP_DEVICE=y
CONFIG_CGROUP_CPUACCT=y
CONFIG_CGROUP_DEBUG=y
CONFIG_NAMESPACES=y
CONFIG_USER_NS=y
CONFIG_CC_OPTIMIZE_FOR_SIZE=y
CONFIG_KALLSYMS_ALL=y
CONFIG_EMBEDDED=y
# CONFIG_SLUB_DEBUG is not set
CONFIG_ARCH_TCC=y
CONFIG_ARCH_TCC897X=y
CONFIG_ARM_THUMBEE=y
CONFIG_SMP=y
CONFIG_SCHED_MC=y
CONFIG_NR_CPUS=8
CONFIG_HIGHMEM=y
CONFIG_ARM_APPENDED_DTB=y
CONFIG_ARM_ATAG_DTB_COMPAT=y
CONFIG_ARM_ATAG_DTB_COMPAT_CMDLINE_EXTEND=y
CONFIG_CPU_FREQ=y
CONFIG_CPU_IDLE=y
CONFIG_KERNEL_MODE_NEON=y
CONFIG_PM_AUTOSLEEP=y
CONFIG_PM_WAKELOCKS=y
CONFIG_MODULES=y
CONFIG_MODULE_UNLOAD=y
CONFIG_MODULE_FORCE_UNLOAD=y
# CONFIG_BLK_DEV_BSG is not set
CONFIG_PARTITION_ADVANCED=y
# CONFIG_CORE_DUMP_DEFAULT_ELF_HEADERS is not set
CONFIG_KSM=y
CONFIG_DEFAULT_MMAP_MIN_ADDR=32768
CONFIG_CMA=y
CONFIG_NET=y
CONFIG_PACKET=y
CONFIG_UNIX=y
# CONFIG_WIRELESS is not set
CONFIG_DEVTMPFS=y
CONFIG_DEVTMPFS_MOUNT=y
CONFIG_BLK_DEV_LOOP=y
# CONFIG_TCC_WMIXER is not set
CONFIG_TCC_SCALER=y
CONFIG_SCSI=m
# CONFIG_SCSI_PROC_FS is not set
CONFIG_BLK_DEV_SD=m
CONFIG_CHR_DEV_SG=m
# CONFIG_SCSI_LOWLEVEL is not set
# CONFIG_INPUT_LEDS is not set
CONFIG_INPUT_EVDEV=y
# CONFIG_INPUT_KEYBOARD is not set
# CONFIG_INPUT_MOUSE is not set
CONFIG_INPUT_TOUCHSCREEN=y
CONFIG_INPUT_MISC=y
CONFIG_INPUT_UINPUT=y
CONFIG_SERIO_LIBPS2=y
# CONFIG_LEGACY_PTYS is not set
CONFIG_SERIAL_TCC=y
CONFIG_SERIAL_TCC_CONSOLE=y
CONFIG_TTY_PRINTK=y
CONFIG_HW_RANDOM=y
# CONFIG_TCC_BT_DEV is not set
CONFIG_TCC_VPU_DRV=m
CONFIG_I2C=y
CONFIG_I2C_CHARDEV=y
CONFIG_SPI=y
CONFIG_SPI_TCC=y
CONFIG_GPIO_TCC=y
CONFIG_SPI_SPIDEV=y
CONFIG_POWER_RESET=y
# CONFIG_HWMON is not set
CONFIG_THERMAL=y
CONFIG_TCC_THERMAL=y
CONFIG_WATCHDOG=y
CONFIG_TCC_PMU_WATCHDOG=y
CONFIG_REGULATOR=y
CONFIG_REGULATOR_FIXED_VOLTAGE=y
CONFIG_REGULATOR_GPIO=y
CONFIG_MEDIA_SUPPORT=y
CONFIG_MEDIA_CAMERA_SUPPORT=y
CONFIG_V4L_PLATFORM_DRIVERS=y
CONFIG_MALI_UTGARD=y
CONFIG_FB=y
CONFIG_FB_NEW=y
CONFIG_FB_TCC_OVERLAY=y
CONFIG_VIDEO_TCC_VOUT=y
CONFIG_BACKLIGHT_CLASS_DEVICE=y
# CONFIG_BACKLIGHT_GENERIC is not set
CONFIG_SOUND=y
CONFIG_SND=y
# CONFIG_SND_SUPPORT_OLD_API is not set
# CONFIG_SND_VERBOSE_PROCFS is not set
# CONFIG_SND_DRIVERS is not set
# CONFIG_SND_ARM is not set
# CONFIG_SND_USB is not set
CONFIG_SND_SOC=y
CONFIG_SND_SOC_TCC=m
CONFIG_SND_SOC_TCC8971_BOARD_LCN3=m
CONFIG_USB=y
CONFIG_USB_ANNOUNCE_NEW_DEVICES=y
CONFIG_USB_MON=y
CONFIG_USB_EHCI_HCD=y
CONFIG_USB_EHCI_TCC=m
CONFIG_USB_EHCI_HCD_PLATFORM=y
CONFIG_USB_OHCI_HCD=y
CONFIG_USB_OHCI_TCC=m
CONFIG_USB_OHCI_HCD_PLATFORM=y
CONFIG_USB_STORAGE=m
CONFIG_USB_DWC2=m
CONFIG_USB_DWC2_TCC=y
CONFIG_TCC_DWC_OTG_PHY=y
CONFIG_USB_GADGET=y
CONFIG_USB_CONFIGFS=y
CONFIG_USB_CONFIGFS_UEVENT=y
CONFIG_USB_CONFIGFS_NCM=y
CONFIG_USB_CONFIGFS_RNDIS=y
CONFIG_USB_CONFIGFS_MASS_STORAGE=y
CONFIG_USB_CONFIGFS_F_FS=y
CONFIG_USB_CONFIGFS_F_ACC=y
CONFIG_USB_CONFIGFS_F_AUDIO_SRC=y
CONFIG_USB_CONFIGFS_F_UAC2=y
CONFIG_USB_CONFIGFS_F_MIDI=y
CONFIG_USB_CONFIGFS_F_IAP2=y
CONFIG_USB_CONFIGFS_F_IAP2_EXT_ACC=y
CONFIG_MMC=y
CONFIG_MMC_BLOCK_MINORS=16
CONFIG_MMC_SDHCI=y
CONFIG_MMC_SDHCI_PLTFM=y
CONFIG_MMC_SDHCI_TCC=y
CONFIG_MMC_SDHCI_TCC_MODULE_ONLY=y
CONFIG_NEW_LEDS=y
CONFIG_LEDS_CLASS=y
CONFIG_LEDS_GPIO=y
CONFIG_LEDS_TRIGGERS=y
CONFIG_LEDS_TRIGGER_TIMER=y
CONFIG_LEDS_TRIGGER_HEARTBEAT=y
CONFIG_RTC_CLASS=y
CONFIG_DMADEVICES=y
CONFIG_STAGING=y
CONFIG_VALIDATE_FS_PARSER=y
CONFIG_EXT2_FS=y
CONFIG_EXT2_FS_XATTR=y
CONFIG_EXT2_FS_POSIX_ACL=y
CONFIG_EXT3_FS=y
CONFIG_EXT3_FS_POSIX_ACL=y
CONFIG_FANOTIFY=y
CONFIG_FUSE_FS=y
CONFIG_MSDOS_FS=y
CONFIG_VFAT_FS=y
CONFIG_FAT_DEFAULT_UTF8=y
CONFIG_TMPFS=y
CONFIG_TMPFS_POSIX_ACL=y
# CONFIG_MISC_FILESYSTEMS is not set
# CONFIG_NETWORK_FILESYSTEMS is not set
CONFIG_NLS_CODEPAGE_437=y
CONFIG_NLS_ASCII=y
CONFIG_NLS_ISO8859_1=y
CONFIG_NLS_UTF8=y
CONFIG_KEYS=y
CONFIG_SECURITY=y
CONFIG_SECURITY_NETWORK=y
CONFIG_CRYPTO_CBC=y
CONFIG_CRYPTO_ESSIV=y
CONFIG_CRYPTO_TWOFISH=y
CONFIG_XZ_DEC=y
CONFIG_DMA_CMA=y
CONFIG_CMA_SIZE_MBYTES=64
CONFIG_PRINTK_TIME=y
CONFIG_DYNAMIC_DEBUG=y
CONFIG_DEBUG_INFO=y
CONFIG_DEBUG_VM=y
CONFIG_PANIC_TIMEOUT=5
CONFIG_SCHEDSTATS=y
# CONFIG_DEBUG_PREEMPT is not set
CONFIG_DEBUG_SPINLOCK=y
CONFIG_ENABLE_DEFAULT_TRACERS=y
CONFIG_DEBUG_USER=y
CONFIG_DEBUG_LL=y
CONFIG_EARLY_PRINTK=y
```

## arch/arm64/configs/tcc803x_linux_cluster_defconfig
```kconfig
CONFIG_LOCALVERSION="-tcc"
# CONFIG_LOCALVERSION_AUTO is not set
# CONFIG_SWAP is not set
CONFIG_SYSVIPC=y
CONFIG_NO_HZ=y
CONFIG_HIGH_RES_TIMERS=y
CONFIG_PREEMPT=y
CONFIG_IKCONFIG=y
CONFIG_IKCONFIG_PROC=y
CONFIG_LOG_BUF_SHIFT=14
CONFIG_CGROUPS=y
CONFIG_MEMCG=y
CONFIG_CGROUP_SCHED=y
CONFIG_RT_GROUP_SCHED=y
CONFIG_CGROUP_FREEZER=y
CONFIG_CGROUP_HUGETLB=y
CONFIG_CGROUP_CPUACCT=y
CONFIG_CGROUP_DEBUG=y
CONFIG_NAMESPACES=y
CONFIG_BLK_DEV_INITRD=y
CONFIG_INITRAMFS_SOURCE="./initramfs-telechips-image-tcc803x.cpio"
# CONFIG_RD_BZIP2 is not set
# CONFIG_RD_LZMA is not set
# CONFIG_RD_XZ is not set
# CONFIG_RD_LZO is not set
# CONFIG_RD_LZ4 is not set
CONFIG_CC_OPTIMIZE_FOR_SIZE=y
CONFIG_KALLSYMS_ALL=y
CONFIG_EMBEDDED=y
CONFIG_ARCH_XGENE=y
CONFIG_ARCH_TCC=y
CONFIG_ARCH_TCC803X=y
CONFIG_SCHED_MC=y
CONFIG_COMPAT=y
# CONFIG_DMI is not set
CONFIG_PM_AUTOSLEEP=y
CONFIG_PM_WAKELOCKS=y
CONFIG_CPU_IDLE=y
CONFIG_CPU_FREQ=y
CONFIG_ARM64_CRYPTO=y
CONFIG_CRYPTO_SHA1_ARM64_CE=y
CONFIG_CRYPTO_SHA2_ARM64_CE=y
CONFIG_CRYPTO_SHA512_ARM64_CE=y
CONFIG_CRYPTO_GHASH_ARM64_CE=y
CONFIG_CRYPTO_AES_ARM64_CE_CCM=y
CONFIG_CRYPTO_AES_ARM64_CE_BLK=y
CONFIG_CRYPTO_CHACHA20_NEON=y
CONFIG_CRYPTO_NHPOLY1305_NEON=y
CONFIG_CRYPTO_AES_ARM64_BS=y
CONFIG_MODULES=y
CONFIG_MODULE_UNLOAD=y
CONFIG_MODULE_FORCE_UNLOAD=y
# CONFIG_BLK_DEV_BSG is not set
# CONFIG_CORE_DUMP_DEFAULT_ELF_HEADERS is not set
CONFIG_KSM=y
CONFIG_TRANSPARENT_HUGEPAGE=y
CONFIG_CMA=y
CONFIG_NET=y
CONFIG_PACKET=y
CONFIG_UNIX=y
CONFIG_CFG80211=y
CONFIG_DEVTMPFS=y
CONFIG_DEVTMPFS_MOUNT=y
# CONFIG_PREVENT_FIRMWARE_BUILD is not set
CONFIG_VIRTIO_BLK=y
# CONFIG_TCC_WMIXER is not set
# CONFIG_TCC_SCALER is not set
CONFIG_SCSI=m
# CONFIG_SCSI_PROC_FS is not set
CONFIG_BLK_DEV_SD=m
CONFIG_CHR_DEV_SG=m
# CONFIG_SCSI_LOWLEVEL is not set
CONFIG_NETDEVICES=y
# CONFIG_INPUT_LEDS is not set
CONFIG_INPUT_MOUSEDEV=m
CONFIG_INPUT_MOUSEDEV_SCREEN_X=1920
CONFIG_INPUT_MOUSEDEV_SCREEN_Y=720
CONFIG_INPUT_EVDEV=y
# CONFIG_INPUT_KEYBOARD is not set
# CONFIG_INPUT_MOUSE is not set
# CONFIG_SERIO is not set
# CONFIG_LEGACY_PTYS is not set
CONFIG_SERIAL_AMBA_PL011=y
CONFIG_SERIAL_AMBA_PL011_CONSOLE=y
CONFIG_HW_RANDOM=y
# CONFIG_TCC_BT_DEV is not set
CONFIG_TCC_VPU_DRV=m
CONFIG_VDEC_CNT_2=y
CONFIG_I2C_CHARDEV=y
CONFIG_SPI=y
CONFIG_SPI_TCC=y
CONFIG_SPI_SPIDEV=y
CONFIG_GPIO_TCC=y
CONFIG_GPIO_PCA953X=y
# CONFIG_HWMON is not set
CONFIG_WATCHDOG=y
CONFIG_TCC_PMU_WATCHDOG=y
CONFIG_MFD_DA9063=y
CONFIG_REGULATOR=y
CONFIG_REGULATOR_FIXED_VOLTAGE=y
CONFIG_REGULATOR_DA9063=y
CONFIG_REGULATOR_GPIO=y
CONFIG_MEDIA_SUPPORT=y
CONFIG_MEDIA_CAMERA_SUPPORT=y
CONFIG_V4L_PLATFORM_DRIVERS=y
CONFIG_DRM=y
CONFIG_FB_NEW=y
CONFIG_BACKLIGHT_CLASS_DEVICE=y
# CONFIG_BACKLIGHT_GENERIC is not set
CONFIG_DUMMY_CONSOLE_COLUMNS=200
CONFIG_LOGO=y
# CONFIG_LOGO_LINUX_MONO is not set
# CONFIG_LOGO_LINUX_VGA16 is not set
# CONFIG_LOGO_LINUX_CLUT224 is not set
CONFIG_SOUND=y
CONFIG_SND=y
# CONFIG_SND_SUPPORT_OLD_API is not set
# CONFIG_SND_PROC_FS is not set
# CONFIG_SND_DRIVERS is not set
# CONFIG_SND_USB is not set
CONFIG_SND_SOC=y
CONFIG_SND_SOC_TCC=m
CONFIG_SND_SOC_AK4601=m
CONFIG_UHID=y
CONFIG_USB=y
CONFIG_USB_XHCI_HCD=m
CONFIG_USB_EHCI_HCD=m
CONFIG_USB_EHCI_TCC=m
CONFIG_USB_OHCI_HCD=m
CONFIG_USB_OHCI_TCC=m
CONFIG_USB_STORAGE=m
CONFIG_USB_DWC3=m
CONFIG_USB_GADGET=y
CONFIG_USB_CONFIGFS=y
CONFIG_USB_CONFIGFS_UEVENT=y
CONFIG_USB_CONFIGFS_SERIAL=y
CONFIG_USB_CONFIGFS_NCM=y
CONFIG_USB_CONFIGFS_MASS_STORAGE=y
CONFIG_USB_CONFIGFS_F_FS=y
CONFIG_USB_CONFIGFS_F_UAC1=y
CONFIG_USB_CONFIGFS_F_UAC2=y
CONFIG_USB_CONFIGFS_F_IAP2=y
CONFIG_USB_CONFIGFS_F_IAP2_EXT_ACC=y
CONFIG_MMC=y
CONFIG_MMC_BLOCK_MINORS=16
CONFIG_MMC_EMBEDDED_SDIO=y
CONFIG_MMC_PARANOID_SD_INIT=y
CONFIG_MMC_SDHCI=y
CONFIG_MMC_SDHCI_PLTFM=y
CONFIG_MMC_SDHCI_TCC=y
CONFIG_MMC_SDHCI_TCC_MODULE_ONLY=y
CONFIG_NEW_LEDS=y
CONFIG_LEDS_CLASS=y
CONFIG_RTC_CLASS=y
# CONFIG_RTC_INTF_SYSFS is not set
# CONFIG_RTC_INTF_PROC is not set
CONFIG_RTC_DRV_XGENE=y
CONFIG_VIRTIO_BALLOON=y
CONFIG_VIRTIO_MMIO=y
CONFIG_STAGING=y
CONFIG_MAILBOX=y
CONFIG_TCC_MULTI_MAILBOX=y
# CONFIG_IOMMU_SUPPORT is not set
CONFIG_PHY_XGENE=y
CONFIG_EXT2_FS=y
CONFIG_EXT3_FS=y
CONFIG_EXT3_FS_POSIX_ACL=y
# CONFIG_DNOTIFY is not set
CONFIG_FUSE_FS=y
CONFIG_VFAT_FS=y
CONFIG_PROC_KCORE=y
CONFIG_TMPFS=y
CONFIG_TMPFS_POSIX_ACL=y
CONFIG_HUGETLBFS=y
# CONFIG_EFIVAR_FS is not set
# CONFIG_MISC_FILESYSTEMS is not set
# CONFIG_NETWORK_FILESYSTEMS is not set
CONFIG_NLS_CODEPAGE_437=y
CONFIG_NLS_ASCII=y
CONFIG_NLS_ISO8859_1=y
CONFIG_NLS_UTF8=y
# CONFIG_CRYPTO_HW is not set
CONFIG_DMA_CMA=y
CONFIG_CMA_SIZE_PERCENTAGE=15
CONFIG_CMA_SIZE_SEL_PERCENTAGE=y
CONFIG_PRINTK_TIME=y
CONFIG_DEBUG_INFO=y
CONFIG_PANIC_ON_OOPS=y
CONFIG_PANIC_TIMEOUT=5
CONFIG_SCHEDSTATS=y
# CONFIG_DEBUG_PREEMPT is not set
# CONFIG_DEBUG_BUGVERBOSE is not set
# CONFIG_FTRACE is not set
```

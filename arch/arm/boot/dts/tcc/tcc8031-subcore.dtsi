// SPDX-License-Identifier: (GPL-2.0-or-later OR MIT)
/*
 * Copyright (C) Telechips Inc.
 */

#include "tcc803x-subcore.dtsi"

/ {
	cpus {
		#address-cells = <1>;
		#size-cells = <0>;

		cpu@0 {
			device_type = "cpu";
			compatible = "arm,cortex-a7";
			enable-method = "psci";
			reg = <0x0>;
			clock-frequency = <1000000000>;
			operating-points = <
				/* kHz    uV */
				1000000  1100000
				925000   1050000
				850000   1000000
				775000   950000
				700000   900000
			>;
		};
	};
};

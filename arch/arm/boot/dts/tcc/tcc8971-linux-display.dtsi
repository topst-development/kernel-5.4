// SPDX-License-Identifier: (GPL-2.0-or-later OR MIT)
/*
 * Copyright (C) Telechips Inc.
 */

#include "tcc897x-display.dtsi"


/ {
	/* Describe here after remove this statement if you have something to be override. */
	tcc_drm_lcd:tcc-drm-lcd {
		status = "okay";
		display-timings {
			native-mode = <&primary_1024x600>;
			primary_1024x600: 1024x600p60 {
				clock-frequency = <51200000>;
				hactive = <1024>;
				vactive = <600>;
				hfront-porch = <147>;
				hback-porch = <147>;
				hsync-len = <19>;
				hsync-active = <0>;
				vback-porch = <10>;
				vfront-porch = <25>;
				vsync-len = <2>;
				vsync-active = <0>;
				de-active = <1>;
				pixelclk-active = <1>;
			};
		};
	};
};
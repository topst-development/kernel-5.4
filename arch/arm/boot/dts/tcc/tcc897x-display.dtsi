// SPDX-License-Identifier: (GPL-2.0-or-later OR MIT)
/*
 * Copyright (C) Telechips Inc.
 */

/ {
	/* Describe here after remove this statement if you have something to be override. */
	tcc-drm-lcd {
		#address-cells = <1>;
		#size-cells = <0>;
		compatible = "telechips,tcc-drm-lcd-v1.0";
		display_device = <&vioc_disp VIOC_DISP0>;
		wmixer = <&vioc_wmix VIOC_WMIX0>;
		rdma = <&vioc_rdma VIOC_RDMA00>;
		planes = "primary";
		status = "disabled";
	};

	tcc-drm-ext {
		#address-cells = <1>;
		#size-cells = <0>;
		compatible = "telechips,tcc-drm-ext-v1.0";
		display_device = <&vioc_disp VIOC_DISP1>;
		wmixer = <&vioc_wmix VIOC_WMIX1>;
		rdma = <&vioc_rdma VIOC_RDMA04>;
		planes = "primary";
		status = "disabled";
	};
};
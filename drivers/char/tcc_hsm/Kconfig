## drivers/char/tcc_hsm/Kconfig
```kconfig
config TCC_HSM
	tristate "TCC HSM"
	default y
	help
		Support to HSM based on Cortex-M4(TCC803x) or HSM Core(TCC805x)
```

## drivers/char/tcc_thsm/Kconfig
```kconfig
config TCC_THSM
	tristate "TCC THSM"
	default n
	help
		Support to THSM based on CA7,R5, <-> CA53 communication
```

## drivers/misc/hdcp/Kconfig
```kconfig
#
# HDCP Configuration
#

config SNPS_HDCP_DP
	bool "HDCP for Synopsys DesignWare Cores DisplayPort"
	depends on TCC_DP_DRIVER_V1_4
	default y
	help
	  Say Y here if you want to support the /dev/hdcp device.
	  The /dev/hdcp device is used to control Synopsys HDCP IP.
	  It supports HDCP1.3.
	  When in doubt, say "Y".
```

## drivers/misc/tcc/Kconfig
```kconfig
config TCC_SHMEM
	default n
	depends on ARCH_TCC
	bool "TCC shared memory driver"

config TCC_WMIXER
  tristate "Telechips Wmixer driver"
  depends on ARCH_TCC
  default y
  help
    Telechips Wmixer driver

config TCC_SCALER
	tristate "Telechips scaler driver"
	depends on ARCH_TCC
	default y
	help
		Telechips scaler driver

config TCC_SDR
	tristate "Telechips DAI Radio Mode Driver"
	depends on (ARCH_TCC803X || ARCH_TCC805X || ARCH_TCC899X || ARCH_TCC901X)
	default n
	help
		Telechips DAI Radio Mode Driver

config GPIO_TCC_SAMPLE
	default n
	depends on PINCTRL_TCC
	depends on ARCH_TCC
	bool "TCC gpio sample driver"
	help
		Telechips GPIO test driver
```

## drivers/soc/tcc/Kconfig
```kconfig
# SPDX-License-Identifier: GPL-2.0-or-later
#
# Copyright (C) Telechips Inc.

menuconfig SOC_TCC
	bool "Telechips SOC drivers support"
	depends on ARCH_TCC

if SOC_TCC

config HAVE_TCC_SIP_SERVICE
	bool

config HAVE_PLAT_TCC_CHIPINFO
	bool

config TCC_BOOTSTAGE
	tristate "Telechips bootstage driver"
	depends on PROC_FS && (ARCH_TCC805X || ARCH_TCC803X)
	default y
	help
	  Select this option to enable Telechips bootstage driver.

	  Telechips bootstage driver creates and manages "bootstage" procfs
	  entry which offers the interface for printing out the boot time
	  information from power on.

	  If unsure, say Y.

config TCC_CHIPINFO
	tristate "Telechips chipinfo driver"
	depends on HAVE_TCC_SIP_SERVICE || HAVE_PLAT_TCC_CHIPINFO
	default y
	help
	  Select this option to enable Telechips chipinfo driver.

	  Telechips chipinfo driver offers various generic functions which
	  provide the chip information (such as revision number) and the boot
	  information (such as boot config selection).

	  If unsure, say Y.

config PM_TCC805X
	bool "Power management driver for TCC805x EVB"
	depends on ARCH_TCC805X && REGULATOR_DA9062
	default y
	help
	  Select this option to enable TCC805x power management driver.

	  TCC805x power management driver controls Dialog Smiconductor PMIC
	  attached on TCC805x SoC based platform on some power events (e.g.
	  suspend, resume) accordingly including some software workarounds
	  for the PMICs if needed.

	  If unsure, say Y.

if PM_TCC805X

config PM_TCC805X_DA9062_SW_WORKAROUND
	bool "Enable software workaround for DA9062 PMIC"
	depends on REGULATOR_DA9062
	default y
	help
	  Select this option to add some software workaround code for DA9062
	  PMIC on TCC805x SoC based platformm, into TCC805x PM driver. By
	  enabling this, (1) CORE0p8 power off timing is delayed for 16.4
	  msec and (2) SYS_EN IRQ is unmasked to get wake-up signal, as the
	  workaround.

	  While only some versions of DA9062 PMICs need this workaround, the
	  others will not be affected by this option. So disable this for
	  such case.

	  If unsure, say Y.

config PM_TCC805X_DA9131_SW_WORKAROUND
	bool "Enable software workaround for DA9131 PMIC"
	depends on REGULATOR_DA9121
	default y
	help
	  Select this option to add some software workaround code for DA9131
	  PMIC on TCC805x SoC based platformm, into TCC805x PM driver. By
	  enabling this, (1) voltage slew rate is adjusted correctly and (2)
	  GPIO1/2 pull-up/pull-down is enabled, as the workaround.

	  While only some versions of DA9131 PMICs need this workaround, the
	  others will not be affected by this option. So disable this for
	  such case.

	  If unsure, say Y.

endif # PM_TCC805X

endif # SOC_TCC
```

## drivers/video/fbdev/tcc-fb/Kconfig
```kconfig
# SPDX-License-Identifier: GPL-2.0-only
#
# telechips fbdev configuration
#

source "drivers/video/fbdev/tcc-fb/vioc/Kconfig"
source "drivers/video/fbdev/tcc-fb/g2d/Kconfig"

if !DRM_TCC
source "drivers/video/fbdev/tcc-fb/vioc/Kconfig"
endif

source "drivers/video/fbdev/tcc-fb/panel/Kconfig"

config FB_NEW
	bool "TSVFB - Telechips Simple VIOC Frame buffer support"
	depends on FB && ARCH_TCC
	select FB_CFB_FILLRECT
	select FB_CFB_COPYAREA
	select FB_CFB_IMAGEBLIT
	default n
	help
		This is Simple Frame buffer driver for Telechips Soc.
		It is complex and difficult to use TVFB because additional functions other
		than UI control function are provided. Therefore, in this frame buffer driver,
		unnecessary functions other than the UI control function are removed.

config FB_TCC_OVERLAY
	tristate "Overlay for Camera/Video"
	depends on FB && ARCH_TCC
	help
	  This is the Overlay device driver for Telechips Soc.
	  The overlay driver is used for video or camera output.

config OVERLAY1
	bool "/dev/overlay1 device support"
	depends on FB_TCC_OVERLAY
	help
	  This is the Overlay1 device driver for Telechips Soc.
	  /dev/overlay1 device support

config TCC_VIDEO_DISPLAY_DEINTERLACE_MODE
	bool "Support Interlaced Video"
	#depends on TCC_VIDEO_DISPLAY_BY_VSYNC_INT
	default y
	help
	  It makes the interlaced video can be displayed smoothly.
```

## drivers/video/fbdev/tcc-fb/vioc/Kconfig
```kconfig
# SPDX-License-Identifier: GPL-2.0-only
#
# telechips drm configuration
#

config TCC_VIOC_LOW_API
	bool "Telechips VIOC LOW APIs"
	depends on ARCH_TCC
	default y

	help
      If true, it supports low api to control VIOC blocks.

if TCC_VIOC_LOW_API
config VIOC_MAP_DECOMP
	bool "VIOC MAP Decompressor support for HEVC"
	depends on (ARCH_TCC803X || ARCH_TCC805X)
	default y

	help
	  TCC VIOC MAP CONVERTER Block.
	  Decompress  HEVC compressed data.

	  If unsure, say N.

config VIOC_AFBCDEC
    bool "Enable AFBC decoder"
    depends on (ARCH_TCC803X) && MALI_MIDGARD
    default n
    help
        TCC AFBC Decoder

config VIOC_PVRIC_FBDC
    bool "Enable PVRIC_FBDC"
    depends on (ARCH_TCC805X) && POWERVR_ROGUE
    default n
    help
        TCC PVRIC Framebuffer decompressor
endif
```

## sound/soc/tcc_tcc897x/Kconfig
```kconfig
config SND_SOC_TCC
	tristate "SoC Audio for the Telechips TCC chip"
	depends on ARCH_TCC && SND_SOC
	help
	  Say Y or M if you want to add support for codecs attached to
	  the TCC I2S interface. You will also need
	  to select the audio interfaces to support below.

config SND_SOC_TCC8971_BOARD_LCN3
	tristate "TCC8971 LCN 3.0"
	select SND_SOC_AK4601
	depends on SND_SOC_TCC && ARCH_TCC897X

	help
	  Say Y if you want to add support for SoC audio on TCC8971 LCN 3.0(AK4601)
```
